## config/boards/shields/cornish/Kconfig.defconfig
```kconfig
if SHIELD_CORNISH_LEFT

config ZMK_KEYBOARD_NAME
    default "Cornish"

config ZMK_SPLIT_ROLE_CENTRAL
    default y

endif

if SHIELD_CORNISH_LEFT || SHIELD_CORNISH_RIGHT

config ZMK_SPLIT
    default y

endif
```

## config/boards/shields/cornish/Kconfig.shield
```kconfig
config SHIELD_CORNISH_LEFT
    def_bool $(shields_list_contains,cornish_left)

config SHIELD_CORNISH_RIGHT
    def_bool $(shields_list_contains,cornish_right)
```
